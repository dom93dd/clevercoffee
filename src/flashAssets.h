/**
 * @file flashAssets.h
 *
 * @brief Orione build (CC_ORIONE): the web page, its fonts, manifest and icons straight from flash
 *        (OrioneWebAssets.h, generated by orione_frontend.py from frontend-orione/). From LittleFS each
 *        file cost up to ~18 KB of heap for a moment and took the web server's stack down to a few hundred
 *        bytes (GET /boot, 08.10.2026). Answers 304 while the browser has the same file (ETag = content
 *        hash), gzip for the page. Behind the request gate like every other answer.
 */

#pragma once

#include <OrioneWebAssets.h>

class FlashAssetHandler : public AsyncWebHandler {
    public:
        bool canHandle(AsyncWebServerRequest* request) const override {
            return (request->method() == HTTP_GET || request->method() == HTTP_HEAD) && find(request->url()) != nullptr;
        }

        bool isRequestHandlerTrivial() const override {
            return true; // nothing to read from the request
        }

        void handleRequest(AsyncWebServerRequest* request) override {
            const orione_web::Asset* a = find(request->url());

            if (a == nullptr) {
                request->send(404, "text/plain", "Not found");
                return;
            }

            AsyncWebServerResponse* response = nullptr;

            if (request->hasHeader("If-None-Match") && request->header("If-None-Match").indexOf(a->etag) >= 0) {
                response = request->beginResponse(304);
            }
            else {
                response = request->beginResponse(200, a->type, a->data, a->size);

                if (a->gzip) {
                    response->addHeader("Content-Encoding", "gzip");
                }
            }

            response->addHeader("ETag", a->etag);
            response->addHeader("Cache-Control", a->cache);
            request->send(response);
        }

    private:
        static const orione_web::Asset* find(const String& url) {
            const char* path = url == "/index.html" ? "/" : url.c_str();

            for (const auto& a : orione_web::kAssets) {
                if (strcmp(a.url, path) == 0) {
                    return &a;
                }
            }

            return nullptr;
        }
};
